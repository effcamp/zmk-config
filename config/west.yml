## config/west.yml
```yaml
manifest:
  remotes:
    - name: zmkfirmware
      url-base: https://github.com/zmkfirmware
    - name: ftc
      url-base: https://github.com/effcamp/ 
  projects:
    - name: zmk
      remote: ftc
      revision: master
      import: app/west.yml
  self:
    path: config
```
